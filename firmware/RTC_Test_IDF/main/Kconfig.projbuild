## firmware/RTC_Test_IDF/main/Kconfig.projbuild
```kconfig
menu "RTC test"

    config RTC_WIFI_SSID
        string "WiFi SSID"
        default "your-ssid"

    config RTC_WIFI_PASSWORD
        string "WiFi password"
        default "your-password"

endmenu
```

## firmware/RTC_Test_IDF/sdkconfig.defaults
```kconfig
CONFIG_IDF_TARGET="esp32c5"
CONFIG_ESPTOOLPY_FLASHSIZE_16MB=y
CONFIG_PARTITION_TABLE_SINGLE_APP_LARGE=y
CONFIG_ESP_CONSOLE_UART_DEFAULT=y
CONFIG_ESP_CONSOLE_SECONDARY_NONE=y
CONFIG_LOG_DEFAULT_LEVEL_WARN=y
CONFIG_FREERTOS_HZ=1000
CONFIG_ESP_MAIN_TASK_STACK_SIZE=8192
CONFIG_LWIP_SNTP_MAX_SERVERS=3
```
